## config/boards/arm/elkhorn/Kconfig
```kconfig
#
# Copyright (c) 2024 Ireh Choi
# SPDX-License-Identifier: MIT
#

config BOARD_ELKHORN_LEFT
    bool

config BOARD_ELKHORN_RIGHT
    bool
```

## config/boards/arm/elkhorn/Kconfig.board
```kconfig
#
# Copyright (c) 2024 Ireh Choi
# SPDX-License-Identifier: MIT
#

config BOARD_ELKHORN_V2_LEFT
    bool "elkhorn left v2"
    depends on SOC_NRF52833_QIAA
    select BOARD_ELKHORN_LEFT

config BOARD_ELKHORN_V2_RIGHT
    bool "elkhorn right v2"
    depends on SOC_NRF52833_QIAA
    select BOARD_ELKHORN_RIGHT
```

## config/boards/arm/elkhorn/Kconfig.defconfig
```kconfig
#
# Copyright (c) 2024 Ireh Choi
# SPDX-License-Identifier: MIT
#

if BOARD_ELKHORN_LEFT

config ZMK_KEYBOARD_NAME
    default "Elkhorn"

config ZMK_SPLIT_ROLE_CENTRAL
    default y

endif # BOARD_ELKHORN_LEFT


if BOARD_ELKHORN_LEFT || BOARD_ELKHORN_RIGHT

config BOARD
    default "elkhorn"

config ZMK_SPLIT
    default y

config BT_CTLR
    default BT


endif # BOARD_ELKHORN_LEFT || BOARD_ELKHORN_RIGHT
```

## config/boards/arm/elkhorn_flat/Kconfig
```kconfig
#
# Copyright (c) 2022 The ZMK Contributors
# SPDX-License-Identifier: MIT
#

config BOARD_ELKHORN_LEFT
    bool

config BOARD_ELKHORN_RIGHT
    bool
```

## config/boards/arm/elkhorn_flat/Kconfig.board
```kconfig
#
# Copyright (c) 2024 Ireh Choi
# SPDX-License-Identifier: MIT
#

config BOARD_ELKHORN_FLAT_V1_LEFT
    bool "elkhorn flat left v1"
    depends on SOC_NRF52833_QIAA
    select BOARD_ELKHORN_FLAT_LEFT

config BOARD_ELKHORN_FLAT_V1_RIGHT
    bool "elkhorn flat right v1"
    depends on SOC_NRF52833_QIAA
    select BOARD_ELKHORN_FLAT_RIGHT
```

## config/boards/arm/elkhorn_flat/Kconfig.defconfig
```kconfig
#
# Copyright (c) 2024 Ireh Choi
# SPDX-License-Identifier: MIT
#

if BOARD_ELKHORN_FLAT_LEFT

config ZMK_KEYBOARD_NAME
    default "Elkhorn Flat"

config ZMK_SPLIT_ROLE_CENTRAL
    default y

endif # BOARD_ELKHORN_FLAT_LEFT


if BOARD_ELKHORN_FLAT_LEFT || BOARD_ELKHORN_FLAT_RIGHT

config BOARD
    default "elkhorn_flat"

config ZMK_SPLIT
    default y

config BT_CTLR
    default BT


endif # BOARD_ELKHORN_FLAT_LEFT || BOARD_ELKHORN_FLAT_RIGHT
```

## config/west.yml
```yaml
manifest:
  remotes:
    - name: zmkfirmware
      url-base: https://github.com/zmkfirmware
    - name: urob
      url-base: https://github.com/urob
  projects:
    - name: zmk
      #remote: urob
      remote: zmkfirmware
      #revision: mouse-3.2
      revision: main
      import: app/west.yml
  self:
    path: config
```
